## package/ko_configfs_sample/Config.in
```kconfig
config BR2_PACKAGE_KO_CONFIGFS_SAMPLE
bool "ko_configfs_sample"
depends on BR2_LINUX_KERNEL
help
Test for adding driver in buildroot

comment "ko_configfs_sample driver needs a Linux kernel to be built"
depends on !BR2_LINUX_KERNEL
```

## package/uvc_app/Config.in
```kconfig
config BR2_PACKAGE_UVC_APP
	bool "uvc_app"
	depends on BR2_riscv
	help
	  k510 uvc app for demo
```
